## Config.in
```kconfig
# BuildRoot 2 SubModule

config BR2SM_PROJECT_NAME
	string
	option env="PROJECT_NAME"
```

## defconfig
```kconfig
BR2_x86_i686=y
# BR2_STRIP_strip is not set
# BR2_COMPILER_PARANOID_UNSAFE_PATH is not set
BR2_TOOLCHAIN_BUILDROOT_VENDOR="nodiot"
BR2_KERNEL_HEADERS_4_15=y
BR2_TOOLCHAIN_BUILDROOT_WCHAR=y
# BR2_UCLIBC_INSTALL_UTILS is not set
BR2_TOOLCHAIN_BUILDROOT_CXX=y
BR2_GCC_ENABLE_LTO=y
BR2_GCC_ENABLE_GRAPHITE=y
BR2_TARGET_GENERIC_HOSTNAME="nodiot"
BR2_TARGET_GENERIC_ISSUE="nodeIoT: https://ponyatov.github.io/nodIoT/"
BR2_ROOTFS_DEVICE_CREATION_DYNAMIC_MDEV=y
BR2_TARGET_GENERIC_ROOT_PASSWD="passwd"
# BR2_TARGET_GENERIC_REMOUNT_ROOTFS_RW is not set
# BR2_ENABLE_LOCALE_PURGE is not set
BR2_LINUX_KERNEL=y
BR2_LINUX_KERNEL_USE_CUSTOM_CONFIG=y
BR2_PACKAGE_NODEJS=y
BR2_PACKAGE_NODEJS_NPM=y
BR2_PACKAGE_NODEJS_MODULES_ADDITIONAL="node-red"
BR2_PACKAGE_LIBMODBUS=y
BR2_PACKAGE_DROPBEAR=y
# BR2_PACKAGE_IFUPDOWN_SCRIPTS is not set
BR2_PACKAGE_MOSQUITTO=y
BR2_TARGET_ROOTFS_CPIO_GZIP=y
BR2_TARGET_ROOTFS_INITRAMFS=y
# BR2_TARGET_ROOTFS_TAR is not set
```

## kernel.defconfig
```kconfig
#
CONFIG_LOCALVERSION="-nodiot"
CONFIG_DEFAULT_HOSTNAME="nodiot"
CONFIG_MODULES=y
CONFIG_MODULE_UNLOAD=y

CONFIG_HYPERVISOR_GUEST=y
CONFIG_PARAVIRT=y
CONFIG_KVM_GUEST=y

CONFIG_PREEMPT=y
CONFIG_NOHIGHMEM=y

CONFIG_NET=y
CONFIG_UNIX=y
CONFIG_INET=y
CONFIG_INET_XFRM_MODE_TRANSPORT=n
CONFIG_INET_XFRM_MODE_TUNNEL=n
CONFIG_INET_XFRM_MODE_BEET=n
CONFIG_IPV6=n

WIRELESS=n

CONFIG_INPUT_KEYBOARD=y
CONFIG_KEYBOARD_ATKBD=y
CONFIG_INPUT_MOUSE=y
CONFIG_MOUSE_PS2=y
CONFIG_MOUSE_SYNAPTICS_USB=y

CONFIG_SERIAL_8250=y
CONFIG_SERIAL_8250_CONSOLE=y

CONFIG_WATCHDOG=y
CONFIG_WATCHDOG_NOWAYOUT=y
CONFIG_SOFT_WATCHDOG=m
CONFIG_ITCO_WDT=m

CONFIG_FB=y
CONFIG_FB_VESA=y
CONFIG_FRAMEBUFFER_CONSOLE=y
CONFIG_LOGO=y
LOGO_LINUX_MONO=y
LOGO_LINUX_VGA16=n
LOGO_LINUX_CLUT224=n

CONFIG_HID_GENERIC=y

CONFIG_USB_SUPPORT=n

CONFIG_RTC_CLASS=y
CONFIG_RTC_DRV_CMOS=y

CONFIG_PRINTK_TIME=y
CONFIG_MAGIC_SYSRQ=y
```
